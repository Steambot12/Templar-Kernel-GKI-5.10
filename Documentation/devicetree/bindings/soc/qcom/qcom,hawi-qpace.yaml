## Documentation/devicetree/bindings/soc/qcom/qcom,hawi-qpace.yaml
```yaml
# SPDX-License-Identifier: (GPL-2.0-only OR BSD-2-Clause)
%YAML 1.2
---
$id: http://devicetree.org/schemas/soc/qcom/qcom,hawi-qpace.yaml#
$schema: http://devicetree.org/meta-schemas/core.yaml#

title: Qualcomm Page Compression Engine (QPaCE)

maintainers:
  - Georgi Djakov <georgi.djakov@oss.qualcomm.com>

description:
  QPaCE is a page-oriented hardware compression engine found on Qualcomm
  SoCs. It is composed of a number of compression, decompression and copy
  engines and exposes both a low-latency urgent path for synchronous
  single-page operations and a high-throughput ring-based path for batched
  asynchronous requests.

properties:
  compatible:
    items:
      - enum:
          - qcom,hawi-qpace

  reg:
    maxItems: 1
    description:
      Single contiguous register window covering all QPaCE sub-regions
      from the GEN registers base through the EE registers.

  iommus:
    items:
      - description: IOMMU mapping for compression engine read DMA
      - description: IOMMU mapping for compression engine write DMA
      - description: IOMMU mapping for decompression engine read DMA
      - description: IOMMU mapping for decompression engine write DMA

  dma-coherent: true

  interconnects:
    maxItems: 1

  interconnect-names:
    items:
      - const: qpace-mem

  interrupts:
    items:
      - description: Ring completion and bus error interrupt
      - description: Urgent command completion interrupt

  interrupt-names:
    items:
      - const: ring-and-bus-err
      - const: urgent

required:
  - compatible
  - reg
  - iommus
  - interconnects
  - interconnect-names
  - interrupts
  - interrupt-names

additionalProperties: false

examples:
  - |
    #include <dt-bindings/interrupt-controller/arm-gic.h>
    #include <dt-bindings/interconnect/qcom,icc.h>
    #include <dt-bindings/interconnect/qcom,hawi-rpmh.h>

    soc {
        #address-cells = <2>;
        #size-cells = <2>;

        compression@31400000 {
            compatible = "qcom,hawi-qpace";
            reg = <0x0 0x31400000 0x0 0x80000>;
            iommus = <&apps_smmu 0x1c20 0x13>,
                     <&apps_smmu 0x1c24 0x13>,
                     <&apps_smmu 0x1c28 0x13>,
                     <&apps_smmu 0x1c2c 0x13>;
            dma-coherent;
            interconnects = <&gem_noc MASTER_QPACE QCOM_ICC_TAG_ALWAYS
                             &mc_virt SLAVE_EBI1 QCOM_ICC_TAG_ALWAYS>;
            interconnect-names = "qpace-mem";
            interrupts = <GIC_ESPI 72 IRQ_TYPE_LEVEL_HIGH>,
                         <GIC_ESPI 71 IRQ_TYPE_LEVEL_HIGH>;
            interrupt-names = "ring-and-bus-err",
                              "urgent";
        };
    };
```

## drivers/block/zram/Kconfig
```kconfig
# SPDX-License-Identifier: GPL-2.0
config ZRAM
	tristate "Compressed RAM block device support"
	depends on BLOCK && SYSFS && ZSMALLOC && CRYPTO
	select CRYPTO_LZ4
	help
	  Creates virtual block devices called /dev/zramX (X = 0, 1, ...).
	  Pages written to these disks are compressed and stored in memory
	  itself. These disks allow very fast I/O and compression provides
	  good amounts of memory savings.

	  It has several use cases, for example: /tmp storage, use as swap
	  disks and maybe many more.

	  See Documentation/admin-guide/blockdev/zram.rst for more information.

config ZRAM_WRITEBACK
       bool "Write back incompressible or idle page to backing device"
       depends on ZRAM
       help
	 With incompressible page, there is no memory saving to keep it
	 in memory. Instead, write it out to backing device.
	 For this feature, admin should set up backing device via
	 /sys/block/zramX/backing_dev.

	 With /sys/block/zramX/{idle,writeback}, application could ask
	 idle page's writeback to the backing device to save in memory.

	 See Documentation/admin-guide/blockdev/zram.rst for more information.

config ZRAM_MEMORY_TRACKING
	bool "Track zRam block status"
	depends on ZRAM && DEBUG_FS
	help
	  With this feature, admin can track the state of allocated blocks
	  of zRAM. Admin could see the information via
	  /sys/kernel/debug/zram/zramX/block_state.

	  See Documentation/admin-guide/blockdev/zram.rst for more information.

config ZRAM_MULTI_COMP
	bool "Enable multiple compression streams"
	depends on ZRAM
	help
	  BACKPORT (mainline v6.2): allow a zram device to be configured with
	  more than one compression algorithm. The primary algorithm is used on
	  the write (swap-out) path as before; up to three additional secondary
	  algorithms can be assigned via /sys/block/zramX/recomp_algorithm and
	  applied to idle/cold pages with /sys/block/zramX/recompress to trade a
	  little CPU for a better compression ratio.

	  When disabled, zram behaves exactly as before (single algorithm).

	  See Documentation/admin-guide/blockdev/zram.rst for more information.

config ZRAM_BACKEND_QPACE
	bool "QPaCE compression support"
	depends on ZRAM
	depends on QCOM_PAGE_COMPRESSION_ENGINE = y || \
		(ZRAM = m && QCOM_PAGE_COMPRESSION_ENGINE = m)
	help
	  Enable Qualcomm Page Compression Engine (QPaCE) hardware
	  acceleration as a zram backend. When selected, zram offloads
	  synchronous compress and decompress operations to the QPaCE
	  urgent command path, reducing CPU overhead.

choice
	prompt "Default zram compressor"
	default ZRAM_DEF_COMP_QPACE if ZRAM_BACKEND_QPACE
	default ZRAM_DEF_COMP_LZ4 if CRYPTO_LZ4
	default ZRAM_DEF_COMP_LZORLE
	depends on ZRAM

config ZRAM_DEF_COMP_QPACE
	bool "qpace-lz4"
	depends on ZRAM_BACKEND_QPACE

config ZRAM_DEF_COMP_LZORLE
	bool "lzo-rle"

config ZRAM_DEF_COMP_LZ4
	bool "lz4"
	depends on CRYPTO_LZ4

config ZRAM_DEF_COMP_LZO
	bool "lzo"
	depends on CRYPTO_LZO

config ZRAM_DEF_COMP_ZSTD
	bool "zstd"
	depends on CRYPTO_ZSTD

endchoice

config ZRAM_DEF_COMP
	string
	default "qpace-lz4" if ZRAM_DEF_COMP_QPACE
	default "lzo-rle" if ZRAM_DEF_COMP_LZORLE
	default "lz4" if ZRAM_DEF_COMP_LZ4
	default "lzo" if ZRAM_DEF_COMP_LZO
	default "zstd" if ZRAM_DEF_COMP_ZSTD
	default "lzo-rle"
```

## drivers/cpuidle/Kconfig
```kconfig
# SPDX-License-Identifier: GPL-2.0-only
menu "CPU Idle"

config CPU_IDLE
	bool "CPU idle PM support"
	default y if ACPI || PPC_PSERIES
	select CPU_IDLE_GOV_LADDER if (!NO_HZ && !NO_HZ_IDLE)
	select CPU_IDLE_GOV_MENU if (NO_HZ || NO_HZ_IDLE) && !CPU_IDLE_GOV_TEO
	help
	  CPU idle is a generic framework for supporting software-controlled
	  idle processor power management.  It includes modular cross-platform
	  governors that can be swapped during runtime.

	  If you're using an ACPI-enabled platform, you should say Y here.

if CPU_IDLE

config CPU_IDLE_MULTIPLE_DRIVERS
	bool

config CPU_IDLE_GOV_LADDER
	bool "Ladder governor (for periodic timer tick)"

config CPU_IDLE_GOV_MENU
	bool "Menu governor (for tickless system)"

config CPU_IDLE_GOV_TEO
	bool "Timer events oriented (TEO) governor (for tickless systems)"
	help
	  This governor implements a simplified idle state selection method
	  focused on timer events and does not do any interactivity boosting.

	  Some workloads benefit from using it and it generally should be safe
	  to use.  Say Y here if you are not happy with the alternatives.

config CPU_IDLE_GOV_HALTPOLL
	bool "Haltpoll governor (for virtualized systems)"
	depends on KVM_GUEST
	help
	  This governor implements haltpoll idle state selection, to be
	  used in conjunction with the haltpoll cpuidle driver, allowing
	  for polling for a certain amount of time before entering idle
	  state.

	  Some virtualized workloads benefit from using it.

config CPU_IDLE_GOV_NAP
	bool "Neural Adaptive Predictor (NAP) governor"
	help
	  This governor predicts, for each idle state, the probability that
	  the upcoming idle will reach that state's target residency, using a
	  small neural network (8->8 MLP trunk with an ordinal survival head)
	  refined by online learning.  It then selects the deepest feasible
	  state whose predicted survival meets a confidence level tunable via
	  /sys/devices/system/cpu/nap/confidence.

	  All arithmetic is fixed point, so no kernel FPU/SIMD is used and
	  results are identical across CPUs.

	  It does not out-rank menu or teo: select it explicitly with
	  cpuidle.governor=nap on the kernel command line.

config CPU_IDLE_GOV_NAP_SELFTEST
	bool "Self-test the NAP governor's fixed-point math at boot"
	depends on CPU_IDLE_GOV_NAP
	help
	  Verify the fixed-point log2, sigmoid and saturating-multiply
	  kernels during boot and report to dmesg.  Useful when porting to a
	  new architecture or toolchain.  Say N for production builds.

config DT_IDLE_STATES
	bool

menu "ARM CPU Idle Drivers"
depends on ARM || ARM64
source "drivers/cpuidle/Kconfig.arm"
endmenu

menu "MIPS CPU Idle Drivers"
depends on MIPS
source "drivers/cpuidle/Kconfig.mips"
endmenu

menu "POWERPC CPU Idle Drivers"
depends on PPC
source "drivers/cpuidle/Kconfig.powerpc"
endmenu

config HALTPOLL_CPUIDLE
	tristate "Halt poll cpuidle driver"
	depends on X86 && KVM_GUEST
	default y
	help
	 This option enables halt poll cpuidle driver, which allows to poll
	 before halting in the guest (more efficient than polling in the
	 host via halt_poll_ns for some scenarios).

endif

config ARCH_NEEDS_CPU_IDLE_COUPLED
	def_bool n
endmenu
```
